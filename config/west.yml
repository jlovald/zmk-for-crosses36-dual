## config/west.yml
```yaml
manifest:
  defaults:
    revision: v0.3
  remotes:
    - name: zmkfirmware
      url-base: https://github.com/zmkfirmware
    - name: Good-Great-Grand-Wonderful
      url-base: https://github.com/Good-Great-Grand-Wonderful
    - name: jlovald
      url-base: https://github.com/jlovald
  projects:
    - name: zmk
      remote: zmkfirmware
      import: app/west.yml
    - name: gggw-zmk-keebs
      remote: jlovald
      revision: main
      import: config/west.yml
  self:
    path: config
```
